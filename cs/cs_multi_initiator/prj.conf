## CMakeLists.txt
```
#
# Copyright (c) 2024 Nordic Semiconductor
#
# SPDX-License-Identifier: LicenseRef-Nordic-5-Clause
#

cmake_minimum_required(VERSION 3.20.0)

find_package(Zephyr REQUIRED HINTS $ENV{ZEPHYR_BASE})
project(channel_sound_ras_initiator)

FILE(GLOB app_sources src/*.c src/*.cpp)
# NORDIC SDK APP START
target_sources(app PRIVATE
  ${app_sources}
  # Sofia's trilateration (shared with the rest of the project, used as is)
  ${CMAKE_CURRENT_LIST_DIR}/../../trilateration/trilateration.cpp
)
target_include_directories(app PRIVATE ${CMAKE_CURRENT_LIST_DIR}/../../trilateration)
# NORDIC SDK APP END
```

## Kconfig
```
#
# Copyright (c) 2026 Nordic Semiconductor ASA
#
# SPDX-License-Identifier: LicenseRef-Nordic-5-Clause
#

menu "Channel Sounding RAS Initiator sample"

choice SAMPLE_RAS_INITIATOR_STEP_MODE
	prompt "Channel Sounding Step Modes selection"
	default SAMPLE_RAS_INITIATOR_STEP_MODE_2_SUB_MODE_1

config SAMPLE_RAS_INITIATOR_STEP_MODE_2_SUB_MODE_1
	bool "Main: 2, Sub: 1."
	help
	  This option enables CS with main mode 2 and submode 1.
	  Mode 2 steps are used for PBR and mode 1 steps are used for RTT.

config SAMPLE_RAS_INITIATOR_STEP_MODE_1
	bool "Main: 1, Sub: unused."
	help
	  This option enables CS with main mode 1 and submode unused.
	  Mode 1 steps are used for RTT.

config SAMPLE_RAS_INITIATOR_STEP_MODE_2
	bool "Main: 2, Sub: unused."
	help
	  This option enables CS with main mode 2 and submode unused.
	  Mode 2 steps are used for PBR.

config SAMPLE_RAS_INITIATOR_STEP_MODE_3
	bool "Main: 3, Sub: unused."
	select BT_RAS_MODE_3_SUPPORTED
	select BT_CTLR_SDC_CS_STEP_MODE3
	help
	  This option enables CS with main mode 3 and submode unused.
	  Mode 3 steps are used for PBR and RTT.

endchoice

endmenu

menu "Indoor localization"

config IL_NUM_BEACONS
	int "Number of beacons (reflectors named IL_B1..IL_B<n>)"
	default 3
	range 1 4

config IL_SAMPLES_PER_TURN
	int "CS distance estimates to collect from a beacon before switching to the next one"
	default 3
	range 1 10

config IL_TURN_TIMEOUT_MS
	int "Maximum time spent on one beacon per turn (ms)"
	default 1500

endmenu

source "Kconfig.zephyr"
```

## prj.conf
```kconfig
#
# Copyright (c) 2024 Nordic Semiconductor ASA
#
# SPDX-License-Identifier: LicenseRef-Nordic-5-Clause
#

CONFIG_NCS_SAMPLES_DEFAULTS=y
CONFIG_DK_LIBRARY=y

CONFIG_BT=y
CONFIG_BT_SMP=y
CONFIG_BT_CENTRAL=y
# One connection per beacon (up to 4)
CONFIG_BT_MAX_CONN=4
CONFIG_BT_CTLR_SDC_CS_COUNT=4
CONFIG_BT_BONDABLE=n

CONFIG_BT_GATT_CLIENT=y
CONFIG_BT_GATT_DYNAMIC_DB=y

CONFIG_BT_CHANNEL_SOUNDING=y
CONFIG_BT_RAS=y
CONFIG_BT_RAS_RREQ=y


# The Ranging Profile recommends a MTU of at least 247 octets.
CONFIG_BT_L2CAP_TX_MTU=498
CONFIG_BT_BUF_ACL_TX_SIZE=502
CONFIG_BT_BUF_ACL_RX_SIZE=502
CONFIG_BT_ATT_PREPARE_COUNT=3
CONFIG_BT_CTLR_DATA_LENGTH_MAX=251

# This reduces RAM usage. Additional RAM is needed to support optional
# features such as mode 3 or multiantenna. Change or remove these if
# using those features
CONFIG_BT_RAS_MODE_3_SUPPORTED=n
CONFIG_BT_RAS_MAX_ANTENNA_PATHS=1
CONFIG_BT_CS_DE_MAX_NUM_ANTENNA_PATHS=1
CONFIG_BT_CTLR_SDC_CS_MAX_ANTENNA_PATHS=1
CONFIG_BT_CTLR_SDC_CS_NUM_ANTENNAS=1
CONFIG_BT_CTLR_SDC_CS_STEP_MODE3=n
CONFIG_BT_CTLR_SDC_CS_ROLE_INITIATOR_ONLY=y

# Disabling the CS Test command reduces flash usage
CONFIG_BT_CTLR_CHANNEL_SOUNDING_TEST=n

# This allows CS and ACL to use different PHYs
CONFIG_BT_TRANSMIT_POWER_CONTROL=y

# This improves the performance of floating-point operations
CONFIG_FPU=y
CONFIG_FPU_SHARING=y

CONFIG_CBPRINTF_FP_SUPPORT=y

CONFIG_BT_CS_DE=y
CONFIG_BT_CS_DE_512_NFFT=y

# Our own scanning (by beacon name) instead of the bt_scan library
CONFIG_BT_OBSERVER=y

# C++ for the shared trilateration code (../../trilateration)
CONFIG_CPP=y
CONFIG_STD_CPP17=y
CONFIG_REQUIRES_FULL_LIBCPP=n
```

## src/trilat_bridge.cpp
```c
/*
 * Bridge between the C firmware (main.c) and Sofia's C++ trilateration
 * (../../../trilateration/trilateration.cpp). Her code is used as is.
 */

#include "trilat_bridge.h"
#include "trilateration.hpp"

extern "C" bool il_trilaterate_2d(const float anchor_xy_m[][2], const float dist_m[], int n,
				  float *x_m, float *y_m)
{
	Anchor anchors[IL_TRILAT_MAX_ANCHORS];

	if (n < 3 || n > IL_TRILAT_MAX_ANCHORS) {
		return false;
	}

	for (int i = 0; i < n; i++) {
		anchors[i].pos.x = anchor_xy_m[i][0];
		anchors[i].pos.y = anchor_xy_m[i][1];
		anchors[i].pos.z = 0.0f;
		anchors[i].distance = dist_m[i];
	}

	Point3D pos;

	if (!Trilateration::calculate_2d_position(anchors, (size_t)n, pos)) {
		return false;
	}

	*x_m = pos.x;
	*y_m = pos.y;
	return true;
}
```

## src/trilat_bridge.h
```c
#pragma once

#include <stdbool.h>

#ifdef __cplusplus
extern "C" {
#endif

#define IL_TRILAT_MAX_ANCHORS 8

/**
 * @brief 2D position from distances to >= 3 beacons (calls Trilateration::calculate_2d_position).
 *
 * @param anchor_xy_m  Beacon coordinates {x, y} in meters, n entries.
 * @param dist_m       Horizontal distances to those beacons in meters, n entries.
 * @param n            Number of beacons (3..IL_TRILAT_MAX_ANCHORS).
 * @return false if there are too few beacons or they are on one line.
 */
bool il_trilaterate_2d(const float anchor_xy_m[][2], const float dist_m[], int n,
		       float *x_m, float *y_m);

#ifdef __cplusplus
}
#endif
```
