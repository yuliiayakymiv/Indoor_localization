## CMakeLists.txt
```
#
# Copyright (c) 2024 Nordic Semiconductor
#
# SPDX-License-Identifier: LicenseRef-Nordic-5-Clause
#

cmake_minimum_required(VERSION 3.20.0)

find_package(Zephyr REQUIRED HINTS $ENV{ZEPHYR_BASE})
project(channel_sound_ras_initiator)

FILE(GLOB app_sources src/*.c src/*.cpp)
# NORDIC SDK APP START
target_sources(app PRIVATE
  ${app_sources}
  # Position code shared with the rest of the project (portable C++, tested on a PC with
  # ../../trilateration/test_tracker.cpp): Sofia's trilateration, the tracker, the laser height
  ${CMAKE_CURRENT_LIST_DIR}/../../trilateration/trilateration.cpp
  ${CMAKE_CURRENT_LIST_DIR}/../../trilateration/tracker.cpp
  ${CMAKE_CURRENT_LIST_DIR}/../../trilateration/height_fusion.cpp
)
target_include_directories(app PRIVATE ${CMAKE_CURRENT_LIST_DIR}/../../trilateration)

if(CONFIG_IL_MAVLINK)
  set(MAVLINK_LIB ${CMAKE_CURRENT_LIST_DIR}/../../lib/mavlink)
  if(NOT EXISTS ${MAVLINK_LIB}/common/mavlink.h)
    message(FATAL_ERROR "lib/mavlink is empty: run 'git submodule update --init lib/mavlink'")
  endif()
  # The team's MAVLink packer, used as is
  target_sources(app PRIVATE ${CMAKE_CURRENT_LIST_DIR}/../../mavlink/mavlink_packer.cpp)
  target_include_directories(app PRIVATE
    ${CMAKE_CURRENT_LIST_DIR}/../../mavlink
    ${MAVLINK_LIB}
  )
  # MAVLink headers use packed structs; silence the noisy GCC warning
  target_compile_options(app PRIVATE -Wno-address-of-packed-member)
endif()
# NORDIC SDK APP END
```

## Kconfig
```
#
# Copyright (c) 2026 Nordic Semiconductor ASA
#
# SPDX-License-Identifier: LicenseRef-Nordic-5-Clause
#

menu "Channel Sounding RAS Initiator sample"

choice SAMPLE_RAS_INITIATOR_STEP_MODE
	prompt "Channel Sounding Step Modes selection"
	default SAMPLE_RAS_INITIATOR_STEP_MODE_2_SUB_MODE_1

config SAMPLE_RAS_INITIATOR_STEP_MODE_2_SUB_MODE_1
	bool "Main: 2, Sub: 1."
	help
	  This option enables CS with main mode 2 and submode 1.
	  Mode 2 steps are used for PBR and mode 1 steps are used for RTT.

config SAMPLE_RAS_INITIATOR_STEP_MODE_1
	bool "Main: 1, Sub: unused."
	help
	  This option enables CS with main mode 1 and submode unused.
	  Mode 1 steps are used for RTT.

config SAMPLE_RAS_INITIATOR_STEP_MODE_2
	bool "Main: 2, Sub: unused."
	help
	  This option enables CS with main mode 2 and submode unused.
	  Mode 2 steps are used for PBR.

config SAMPLE_RAS_INITIATOR_STEP_MODE_3
	bool "Main: 3, Sub: unused."
	select BT_RAS_MODE_3_SUPPORTED
	select BT_CTLR_SDC_CS_STEP_MODE3
	help
	  This option enables CS with main mode 3 and submode unused.
	  Mode 3 steps are used for PBR and RTT.

endchoice

endmenu

menu "Indoor localization"

config IL_NUM_BEACONS
	int "Number of beacons (reflectors named IL_B1..IL_B<n>)"
	default 3
	range 1 4

config IL_BEACON_ID
	int "Role of this board: 0 = mobile node, 1..4 = beacon IL_B<id>"
	default 0
	range 0 4
	help
	  0 builds the mobile node (drone). 1..4 builds a beacon: at boot it measures the
	  distance to every beacon with a higher id, then advertises as IL_B<id> (with the
	  measured distances) and answers the mobile node as a CS reflector.
	  A beacon build also needs -DEXTRA_CONF_FILE=beacon.conf.

config IL_AUTO_LAYOUT
	bool "Build the coordinate plane from the distances measured by the beacons"
	default y
	help
	  y: the mobile node waits until the beacons have measured the distances between
	  each other and builds the coordinate plane from them.
	  n: the distances are the BEACON_Dxx_MM constants in src/main.c.

config IL_EXTERNAL_ANTENNA
	bool "Use the external antenna (U.FL connector) instead of the onboard one"
	default y
	select GPIO
	help
	  y: the XIAO RF switch (P2.05) selects the U.FL connector, the FPC antenna must be
	  plugged in. n: the onboard ceramic antenna. See src/antenna.c.
	  The distance calibration in src/main.c was re-fitted on 18.11.2026 with the external
	  antennas; recalibrate after switching to the onboard one.

config IL_SLEEP_BUTTON
	bool "Sleep button on D0 (to GND): press to sleep, press again to wake up"
	default y
	select GPIO
	select POWEROFF
	help
	  See src/sleep_button.c. The pin is set in boards/xiao_nrf54l15_nrf54l15_cpuapp.overlay.
	  Without a button the pin is only pulled up and nothing happens.

config IL_RAW_OUTPUT
	bool "Print a $RAW line with the uncalibrated distance estimates (for calibration)"
	default n

config IL_MAVLINK
	bool "Send the position as MAVLink on pins D6 (TX) / D7 (RX)"
	default y if IL_BEACON_ID = 0
	depends on SERIAL
	help
	  Mobile node: HEARTBEAT once a second and VISION_POSITION_ESTIMATE after every
	  position, MAVLink v2, on uart21 (115200 baud). The text output stays on the console.
	  Uses ../../mavlink/mavlink_packer.cpp and the lib/mavlink submodule
	  (git submodule update --init lib/mavlink).

config IL_DEFAULT_MODE_DRONE
	bool "Mobile node starts in DRONE mode (3D) instead of CAR mode (2D)"
	default n
	help
	  CAR: 2D, only IL_B1..IL_B3 are used (IL_B4 is ignored and not ranged), z is the
	  antenna height of the car (IL_CAR_ANTENNA_Z_MM).
	  DRONE: 3D with every beacon, z also from a laser rangefinder if there is one.
	  The mode can be switched at run time with "$MODE,CAR" / "$MODE,DRONE" on the console
	  (the map page does that, see tools/map).

config IL_CAR_ANTENNA_Z_MM
	int "Antenna height of the mobile node on the car, mm above the floor"
	default 0

config IL_BEACON_BASE_Z_MM
	int "Antenna height of IL_B1..IL_B3 above the floor, mm (all three the same)"
	default 0
	help
	  z of the position is measured from the floor, so the laser height of the drone can be
	  compared with it. Put B1..B3 at the same height (e.g. on equal boxes) and enter it here.

config IL_BEACON4_Z_MM
	int "Antenna height of IL_B4 above the floor, mm (0 = compute from the distances)"
	default 0
	help
	  0: z of IL_B4 is computed from its distances to IL_B1..IL_B3 (needs a height
	  difference of at least ~1 m to be useful). A value measured with a tape is more precise.

config IL_LAYOUT_CORRECTION_MM
	int "Correction added to every beacon-to-beacon distance, mm"
	default 290
	range -1000 1000
	help
	  The beacons measure each other short: on 19.11.2026 the sides came out 2.20 / 2.16 /
	  2.11 m for 2.50 / 2.38 / 2.46 m (on average 290 mm short), because the calibration was
	  fitted on the mobile node <-> beacon link. Only used with IL_AUTO_LAYOUT. Set 0 to use
	  the measured distances as they are.

config IL_B4_LAYOUT_WAIT_S
	int "Mobile node: how long to wait for the IL_B4 distances after the B1-B2-B3 triangle, s"
	default 60
	help
	  The triangle B1-B2-B3 is enough to start. IL_B4 (only with IL_NUM_BEACONS=4) is used
	  as soon as its distances arrive within this time; otherwise the node starts without it
	  (CAR mode does not need it).

config IL_SURVEY_OPTIONAL_S
	int "Beacon: give up on an IL_B4 that is never found after this time, s"
	default 90
	help
	  A beacon measures every beacon with a higher id at boot. IL_B4 is optional: if it is
	  not found at all within this time (not switched on), the beacon stops looking for it
	  and does not reboot to retry, so the 3-beacon system still starts quickly.

config IL_COMMANDS
	bool "Mobile node: text commands on the console ($MODE, $LSR)"
	default y if IL_BEACON_ID = 0
	depends on SERIAL
	select UART_INTERRUPT_DRIVEN
	select RING_BUFFER
	help
	  $MODE,CAR / $MODE,DRONE  switch the mode (the map page sends it);
	  $LSR,<range_mm>,<roll_cdeg>,<pitch_cdeg>  one laser rangefinder sample (if the
	  rangefinder is read by the Raspberry Pi; for tests). See src/il_cmd.c.

config IL_LASER_FROM_FC
	bool "Read the laser rangefinder and the attitude from the flight controller (MAVLink)"
	default y
	depends on IL_MAVLINK && IL_COMMANDS
	help
	  Parses DISTANCE_SENSOR (downward, orientation PITCH_270) and ATTITUDE from the flight
	  controller on the MAVLink UART RX (pin D7). In ArduPilot: SERIALx_PROTOCOL = 2,
	  stream rates SRx_EXTRA1 (ATTITUDE) and SRx_EXTRA3 (DISTANCE_SENSOR) at 10 Hz.

config IL_SAMPLES_PER_TURN
	int "CS distance estimates to collect from a beacon before switching to the next one"
	default 3
	range 1 10

config IL_TURN_TIMEOUT_MS
	int "Maximum time spent on one beacon per turn (ms)"
	default 1500

endmenu

source "Kconfig.zephyr"
```

## prj.conf
```kconfig
#
# Copyright (c) 2024 Nordic Semiconductor ASA
#
# SPDX-License-Identifier: LicenseRef-Nordic-5-Clause
#

CONFIG_NCS_SAMPLES_DEFAULTS=y
CONFIG_DK_LIBRARY=y

CONFIG_BT=y
CONFIG_BT_SMP=y
CONFIG_BT_CENTRAL=y
# One connection per beacon (up to 4)
CONFIG_BT_MAX_CONN=4
# One SMP key slot per beacon link (default is 1 -> only one beacon can be encrypted)
CONFIG_BT_MAX_PAIRED=4
CONFIG_BT_CTLR_SDC_CS_COUNT=4
# Each link reserves this much radio time per connection event (default 7500 us).
# Keep it short so a 16 ms CS subevent fits between the events of the other links.
CONFIG_BT_CTLR_SDC_MAX_CONN_EVENT_LEN_DEFAULT=3000
# Spacing between the ACL events of the links (CS default is 90000 us, more than
# the 40..55 ms connection intervals).
CONFIG_BT_CTLR_SDC_CENTRAL_ACL_EVENT_SPACING_DEFAULT=13000
CONFIG_BT_BONDABLE=n

CONFIG_BT_GATT_CLIENT=y
CONFIG_BT_GATT_DYNAMIC_DB=y

CONFIG_BT_CHANNEL_SOUNDING=y
CONFIG_BT_RAS=y
CONFIG_BT_RAS_RREQ=y


# The Ranging Profile recommends a MTU of at least 247 octets.
CONFIG_BT_L2CAP_TX_MTU=498
CONFIG_BT_BUF_ACL_TX_SIZE=502
CONFIG_BT_BUF_ACL_RX_SIZE=502
CONFIG_BT_ATT_PREPARE_COUNT=3
CONFIG_BT_CTLR_DATA_LENGTH_MAX=251

# This reduces RAM usage. Additional RAM is needed to support optional
# features such as mode 3 or multiantenna. Change or remove these if
# using those features
CONFIG_BT_RAS_MODE_3_SUPPORTED=n
CONFIG_BT_RAS_MAX_ANTENNA_PATHS=1
CONFIG_BT_CS_DE_MAX_NUM_ANTENNA_PATHS=1
CONFIG_BT_CTLR_SDC_CS_MAX_ANTENNA_PATHS=1
CONFIG_BT_CTLR_SDC_CS_NUM_ANTENNAS=1
CONFIG_BT_CTLR_SDC_CS_STEP_MODE3=n
CONFIG_BT_CTLR_SDC_CS_ROLE_INITIATOR_ONLY=y

# Disabling the CS Test command reduces flash usage
CONFIG_BT_CTLR_CHANNEL_SOUNDING_TEST=n

# This allows CS and ACL to use different PHYs
CONFIG_BT_TRANSMIT_POWER_CONTROL=y

# This improves the performance of floating-point operations
CONFIG_FPU=y
CONFIG_FPU_SHARING=y

CONFIG_CBPRINTF_FP_SUPPORT=y

CONFIG_BT_CS_DE=y
CONFIG_BT_CS_DE_2048_NFFT=y

# Our own scanning (by beacon name) instead of the bt_scan library
CONFIG_BT_OBSERVER=y

# C++ for the shared trilateration code (../../trilateration)
CONFIG_CPP=y
CONFIG_STD_CPP17=y
CONFIG_REQUIRES_FULL_LIBCPP=n
```

## beacon.conf
```kconfig
#
# Extra configuration of a BEACON build (on top of prj.conf):
#   west build -b xiao_nrf54l15/nrf54l15/cpuapp -d build_b1 --pristine -- \
#       -DEXTRA_CONF_FILE=beacon.conf -DCONFIG_IL_BEACON_ID=1
#
# A beacon is a CS initiator while it measures the other beacons at boot (central),
# then a CS reflector for the mobile node (peripheral).
#

CONFIG_BT_PERIPHERAL=y
CONFIG_BT_RAS_RRSP=y
CONFIG_BT_RAS_RRSP_MAX_ACTIVE_CONN=2

CONFIG_BT_CTLR_SDC_CS_ROLE_INITIATOR_ONLY=n
CONFIG_BT_CTLR_SDC_CS_ROLE_BOTH=y

# Same as the stock Nordic reflector: the initiating device controls the link
CONFIG_BT_GAP_AUTO_UPDATE_CONN_PARAMS=n
CONFIG_BT_AUTO_PHY_UPDATE=n
CONFIG_BT_CTLR_PHY_2M=y

# The beacon reboots itself if the beacon-to-beacon measurement hangs or is incomplete
CONFIG_REBOOT=y

# Beacons run on a battery (18650 on the BAT pads), without USB. A beacon prints nothing that
# is needed, so the console UART is off: with it on, the UART TX pin back-powers the unpowered
# USB-UART bridge of the XIAO and the board may not start until USB is plugged in.
CONFIG_SERIAL=n
CONFIG_UART_CONSOLE=n
```

## log_on.conf
```kconfig
# debug only: beacon with the log on USB
CONFIG_SERIAL=y
CONFIG_UART_CONSOLE=y
```

## uart_pins.overlay
```dts
/*
 * Mobile node on the drone battery, without USB:
 *   west build -b xiao_nrf54l15/nrf54l15/cpuapp --pristine -- -DEXTRA_DTC_OVERLAY_FILE=uart_pins.overlay
 *
 * The console ($RNG, $POS and the log, 115200 baud) moves from the USB port (uart20) to the
 * pins D6 = TX (P2.08) and D7 = RX (P2.07) (uart21), for the Raspberry Pi / flight controller.
 * uart20 is turned off: on a battery the USB-UART bridge of the XIAO is not powered, and a
 * driven TX line would back-power it, so the board may not start.
 */
/ {
	chosen {
		zephyr,console = &uart21;
		zephyr,shell-uart = &uart21;
	};
};

&uart20 {
	status = "disabled";
};
```

## boards/xiao_nrf54l15_nrf54l15_cpuapp.overlay
```dts
/*
 * Sleep button: between D0 (P1.04) and GND. Press it to put the board to sleep
 * (System OFF), press again to wake it up. See src/sleep_button.c.
 */
/ {
	zephyr,user {
		sleep-button-gpios = <&xiao_d 0 (GPIO_PULL_UP | GPIO_ACTIVE_LOW)>;
	};
};
```

## src/antenna.c
```c
/*
 * Antenna selection on the Seeed XIAO nRF54L15.
 *
 * The 2.4 GHz path goes through an RF switch:
 *   P2.03 (rfsw_pwr) - powers the switch; without power NO antenna is connected
 *   P2.05 (rfsw_ctl) - physical LOW = onboard ceramic antenna, HIGH = U.FL (external)
 *
 * The pins are driven by their physical level on purpose: the Zephyr and Seeed board
 * files disagree on the polarity flag of rfsw_ctl, so the logical value is not reliable.
 * Runs at APPLICATION level, after the board's regulator setup, before main().
 */

#include <zephyr/kernel.h>
#include <zephyr/init.h>
#include <zephyr/drivers/gpio.h>
#include <zephyr/logging/log.h>

LOG_MODULE_REGISTER(antenna, LOG_LEVEL_INF);

#define RFSW_PWR_PIN 3
#define RFSW_CTL_PIN 5

static int antenna_select(void)
{
	const struct device *gpio2 = DEVICE_DT_GET(DT_NODELABEL(gpio2));

	if (!device_is_ready(gpio2)) {
		LOG_ERR("gpio2 not ready, antenna not switched");
		return -ENODEV;
	}

	int err = gpio_pin_configure(gpio2, RFSW_PWR_PIN, GPIO_OUTPUT_HIGH);

	if (!err) {
		err = gpio_pin_configure(gpio2, RFSW_CTL_PIN,
					 IS_ENABLED(CONFIG_IL_EXTERNAL_ANTENNA) ? GPIO_OUTPUT_HIGH
										: GPIO_OUTPUT_LOW);
	}
	if (err) {
		LOG_ERR("RF switch GPIO error %d", err);
		return err;
	}

	LOG_INF("Antenna: %s", IS_ENABLED(CONFIG_IL_EXTERNAL_ANTENNA) ? "external (U.FL)"
								      : "onboard");
	return 0;
}

SYS_INIT(antenna_select, APPLICATION, CONFIG_APPLICATION_INIT_PRIORITY);
```

## src/beacon_reflector.c
```c
/*
 * Reflector role of a beacon (beacon build only, CONFIG_IL_BEACON_ID > 0).
 *
 * Based on Nordic's ras_reflector sample (../../cs_reflector). Differences:
 *  - the advertisement also carries the distances this beacon measured to the other
 *    beacons (see il_beacon.h), so the mobile node can build the coordinate plane;
 *  - after a disconnect the beacon advertises again instead of rebooting (a reboot would
 *    repeat the beacon-to-beacon measurement).
 */

#include <zephyr/kernel.h>

#if CONFIG_IL_BEACON_ID > 0

#include <string.h>
#include <zephyr/bluetooth/bluetooth.h>
#include <zephyr/bluetooth/conn.h>
#include <zephyr/bluetooth/uuid.h>
#include <zephyr/bluetooth/cs.h>
#include <zephyr/sys/byteorder.h>
#include <bluetooth/services/ras.h>
#include <dk_buttons_and_leds.h>
#include "led_status.h"

#include "il_beacon.h"

#include <zephyr/logging/log.h>
LOG_MODULE_REGISTER(il_reflector, LOG_LEVEL_INF);

BUILD_ASSERT(IS_ENABLED(CONFIG_BT_PERIPHERAL) && IS_ENABLED(CONFIG_BT_RAS_RRSP),
	     "A beacon build needs -DEXTRA_CONF_FILE=beacon.conf");

#define IL_BEACON_NAME "IL_B" STRINGIFY(CONFIG_IL_BEACON_ID)

/* Up to 3 other beacons */
#define MAX_DIST_ENTRIES_LEN (3 * IL_ADV_ENTRY_LEN)

static uint8_t mfg_data[sizeof(uint16_t) + MAX_DIST_ENTRIES_LEN];

static struct bt_data ad[] = {
	BT_DATA_BYTES(BT_DATA_FLAGS, (BT_LE_AD_GENERAL | BT_LE_AD_NO_BREDR)),
	BT_DATA_BYTES(BT_DATA_UUID16_ALL, BT_UUID_16_ENCODE(BT_UUID_RANGING_SERVICE_VAL)),
	BT_DATA(BT_DATA_NAME_COMPLETE, IL_BEACON_NAME, sizeof(IL_BEACON_NAME) - 1),
	BT_DATA(BT_DATA_MANUFACTURER_DATA, mfg_data, sizeof(uint16_t)),
};

static bool reflector_active;
/* The link to the mobile node; reference owned by the connection callbacks. */
static struct bt_conn *periph_conn;
/* Set when the mobile node has created the CS config on periph_conn. */
static struct bt_conn *config_done_for;

/* New connections for the main loop; every entry carries its own reference. */
K_MSGQ_DEFINE(new_conn_q, sizeof(struct bt_conn *), 2, sizeof(void *));

static void adv_work_handler(struct k_work *work)
{
	int err;

	if (!reflector_active || periph_conn != NULL) {
		return;
	}

	err = bt_le_adv_start(BT_LE_ADV_CONN_FAST_2, ad, ARRAY_SIZE(ad), NULL, 0);
	if (err && err != -EALREADY) {
		LOG_ERR("Advertising failed to start (err %d)", err);
	}
}

static K_WORK_DEFINE(adv_work, adv_work_handler);

static void connected_cb(struct bt_conn *conn, uint8_t err)
{
	struct bt_conn_info info;
	struct bt_conn *ref;

	if (bt_conn_get_info(conn, &info) != 0 || info.role != BT_CONN_ROLE_PERIPHERAL) {
		return; /* a link this beacon created itself (beacon-to-beacon measurement) */
	}

	if (err) {
		LOG_WRN("Incoming connection failed (err 0x%02X)", err);
		return;
	}

	LOG_INF("Mobile node (or another beacon) connected");

	config_done_for = NULL;
	periph_conn = bt_conn_ref(conn);

	ref = bt_conn_ref(conn);
	if (k_msgq_put(&new_conn_q, &ref, K_NO_WAIT) != 0) {
		bt_conn_unref(ref);
	}

	led_status_set(LED_STATUS_CONNECTED);
}

static void disconnected_cb(struct bt_conn *conn, uint8_t reason)
{
	if (conn != periph_conn) {
		return;
	}

	LOG_INF("Disconnected (reason 0x%02X)", reason);

	bt_conn_unref(periph_conn);
	periph_conn = NULL;

	led_status_set(LED_STATUS_ON);
}

static void recycled_cb(void)
{
	/* A connection object is free again: advertising can be restarted. */
	k_work_submit(&adv_work);
}

static void config_create_cb(struct bt_conn *conn, uint8_t status,
			     struct bt_conn_le_cs_config *config)
{
	ARG_UNUSED(config);

	if (conn != periph_conn) {
		return;
	}

	if (status == BT_HCI_ERR_SUCCESS) {
		config_done_for = conn;
	} else {
		LOG_WRN("CS config creation failed. (HCI status 0x%02x)", status);
	}
}

BT_CONN_CB_DEFINE(reflector_conn_cb) = {
	.connected = connected_cb,
	.disconnected = disconnected_cb,
	.recycled = recycled_cb,
	.le_cs_config_complete = config_create_cb,
};

bool il_reflector_busy(void)
{
	return periph_conn != NULL;
}

void il_reflector_run(const uint8_t *dist_entries, size_t len)
{
	int err;

	len = MIN(len, MAX_DIST_ENTRIES_LEN);
	sys_put_le16(IL_ADV_COMPANY_ID, mfg_data);
	if (len > 0) {
		memcpy(&mfg_data[sizeof(uint16_t)], dist_entries, len);
	}
	ad[ARRAY_SIZE(ad) - 1].data_len = sizeof(uint16_t) + len;

	LOG_INF("Beacon %s: advertising, waiting for the mobile node", IL_BEACON_NAME);

	led_status_set(LED_STATUS_ON);
	reflector_active = true;
	k_work_submit(&adv_work);

	while (true) {
		struct bt_conn *conn;

		/* Every 2 s without a new connection: make sure the beacon advertises. The
		 * restart in recycled_cb() is a single attempt; if it fails (or the event is
		 * missed) the beacon would stay invisible until a reboot. adv_work does nothing
		 * while connected, and -EALREADY (already advertising) is ignored.
		 */
		if (k_msgq_get(&new_conn_q, &conn, K_SECONDS(2)) != 0) {
			k_work_submit(&adv_work);
			continue;
		}

		const struct bt_le_cs_set_default_settings_param default_settings = {
			.enable_initiator_role = false,
			.enable_reflector_role = true,
			.cs_sync_antenna_selection = BT_LE_CS_ANTENNA_SELECTION_OPT_REPETITIVE,
			.max_tx_power = BT_HCI_OP_LE_CS_MAX_MAX_TX_POWER,
		};

		err = bt_le_cs_set_default_settings(conn, &default_settings);
		if (err) {
			LOG_ERR("Failed to configure default CS settings (err %d)", err);
		}

		/* The initiator creates the CS config; stop waiting if it disconnects. */
		while (periph_conn == conn && config_done_for != conn) {
			k_sleep(K_MSEC(50));
		}

		if (periph_conn == conn) {
			const struct bt_le_cs_set_procedure_parameters_param procedure_params = {
				.config_id = 0,
				.max_procedure_len = 1000,
				.min_procedure_interval = 1,
				.max_procedure_interval = 100,
				.max_procedure_count = 0,
				.min_subevent_len = 10000,
				.max_subevent_len = 75000,
				.tone_antenna_config_selection =
					BT_LE_CS_TONE_ANTENNA_CONFIGURATION_A1_B1,
				.phy = BT_LE_CS_PROCEDURE_PHY_2M,
				.tx_power_delta = 0x80,
				.preferred_peer_antenna =
					BT_LE_CS_PROCEDURE_PREFERRED_PEER_ANTENNA_1,
				.snr_control_initiator = BT_LE_CS_SNR_CONTROL_NOT_USED,
				.snr_control_reflector = BT_LE_CS_SNR_CONTROL_NOT_USED,
			};

			err = bt_le_cs_set_procedure_parameters(conn, &procedure_params);
			if (err) {
				LOG_ERR("Failed to set procedure parameters (err %d)", err);
			}
		}

		bt_conn_unref(conn);
	}
}

#endif /* CONFIG_IL_BEACON_ID > 0 */
```

## src/cs_pos.c
```c
#include "cs_pos.h"
#include <math.h>
#include <string.h>

void cs_pos_init(cs_pos_t *s, const float xy_mm[][2], uint8_t count)
{
	memset(s, 0, sizeof(*s));
	if (count > CS_POS_MAX_BEACONS) {
		count = CS_POS_MAX_BEACONS;
	}
	s->count = count;
	for (uint8_t i = 0; i < count; i++) {
		s->b[i].x_mm = xy_mm[i][0];
		s->b[i].y_mm = xy_mm[i][1];
	}
}

static float median(const float *v, uint8_t n)
{
	float t[CS_POS_WIN];
	memcpy(t, v, n * sizeof(float));
	for (uint8_t i = 1; i < n; i++) {          /* insertion sort, n <= 5 */
		float k = t[i];
		int j = i - 1;
		while (j >= 0 && t[j] > k) { t[j + 1] = t[j]; j--; }
		t[j + 1] = k;
	}
	return (n & 1) ? t[n / 2] : 0.5f * (t[n / 2 - 1] + t[n / 2]);
}

static void push(cs_beacon_t *b, float d)
{
	b->buf[b->head] = d;
	b->head = (b->head + 1) % CS_POS_WIN;
	if (b->n < CS_POS_WIN) {
		b->n++;
	}
}

void cs_pos_add(cs_pos_t *s, uint8_t idx, bool valid, float d, int64_t now_ms)
{
	if (idx >= s->count || !valid || !(d > 0.0f) || d > 50.0f) {
		return;                             /* timeout / garbage: keep the old value */
	}
	cs_beacon_t *b = &s->b[idx];

	/* old buffer → start over */
	if (b->ever && now_ms - b->last_ms > CS_POS_MAX_AGE_MS) {
		b->n = b->head = 0;
	}

	if (b->n >= 3 && fabsf(d - median(b->buf, b->n)) > CS_POS_OUTLIER_M) {
		if (b->rejected > 0.0f && fabsf(d - b->rejected) < CS_POS_OUTLIER_M) {
			/* two consistent "outliers" in a row → it really moved */
			b->n = b->head = 0;
			push(b, b->rejected);
		} else {
			b->rejected = d;            /* single spike, reject */
			return;
		}
	}
	b->rejected = 0.0f;
	push(b, d);
	b->last_ms = now_ms;
	b->ever = true;
}

bool cs_pos_dist(const cs_pos_t *s, uint8_t idx, int64_t now_ms, float *d)
{
	const cs_beacon_t *b = &s->b[idx];
	if (!b->ever || b->n == 0 || now_ms - b->last_ms > CS_POS_MAX_AGE_MS) {
		return false;
	}
	*d = median(b->buf, b->n);
	return true;
}

bool cs_pos_solve(cs_pos_t *s, int64_t now_ms, cs_fix_t *out)
{
	float bx[CS_POS_MAX_BEACONS], by[CS_POS_MAX_BEACONS], r[CS_POS_MAX_BEACONS];
	uint8_t n = 0, stale = 0;

	for (uint8_t i = 0; i < s->count; i++) {
		float d;
		if (cs_pos_dist(s, i, now_ms, &d)) {
			bx[n] = s->b[i].x_mm;
			by[n] = s->b[i].y_mm;
			r[n] = d * 1000.0f;
			/* stale = no fresh measurement in the current cycle */
			if (now_ms - s->b[i].last_ms > CS_POS_STALE_MS) {
				stale++;
			}
			n++;
		}
	}
	if (n < 3) {
		return false;
	}

	/* 1) Linear LS: subtract beacon 0's equation from the rest */
	float a11 = 0, a12 = 0, a22 = 0, c1 = 0, c2 = 0;
	for (uint8_t i = 1; i < n; i++) {
		float ax = 2.0f * (bx[i] - bx[0]);
		float ay = 2.0f * (by[i] - by[0]);
		float rhs = r[0] * r[0] - r[i] * r[i]
			  + bx[i] * bx[i] - bx[0] * bx[0]
			  + by[i] * by[i] - by[0] * by[0];
		a11 += ax * ax; a12 += ax * ay; a22 += ay * ay;
		c1 += ax * rhs; c2 += ay * rhs;
	}
	float det = a11 * a22 - a12 * a12;
	if (fabsf(det) < 1e-6f) {
		return false;                       /* beacons on one line */
	}
	float x = (a22 * c1 - a12 * c2) / det;
	float y = (a11 * c2 - a12 * c1) / det;

	/* 2) Gauss-Newton on the true distances (more accurate than the linearisation) */
	for (int it = 0; it < 5; it++) {
		float h11 = 0, h12 = 0, h22 = 0, g1 = 0, g2 = 0;
		for (uint8_t i = 0; i < n; i++) {
			float dx = x - bx[i], dy = y - by[i];
			float dist = sqrtf(dx * dx + dy * dy);
			if (dist < 1.0f) {
				dist = 1.0f;
			}
			float jx = dx / dist, jy = dy / dist;
			float e = dist - r[i];
			h11 += jx * jx; h12 += jx * jy; h22 += jy * jy;
			g1 += jx * e;   g2 += jy * e;
		}
		float hd = h11 * h22 - h12 * h12;
		if (fabsf(hd) < 1e-9f) {
			break;
		}
		float sx = (h22 * g1 - h12 * g2) / hd;
		float sy = (h11 * g2 - h12 * g1) / hd;
		x -= sx;
		y -= sy;
		if (fabsf(sx) + fabsf(sy) < 0.5f) {
			break;
		}
	}

	float ss = 0;
	for (uint8_t i = 0; i < n; i++) {
		float dx = x - bx[i], dy = y - by[i];
		float e = sqrtf(dx * dx + dy * dy) - r[i];
		ss += e * e;
	}

	/* 3) EMA */
	if (!s->have_pos) {
		s->px = x; s->py = y; s->have_pos = true;
	} else {
		s->px += CS_POS_EMA_ALPHA * (x - s->px);
		s->py += CS_POS_EMA_ALPHA * (y - s->py);
	}

	out->x_mm = s->px;
	out->y_mm = s->py;
	out->resid_mm = sqrtf(ss / n);
	out->used = n;
	out->stale = stale;
	return true;
}
```

## src/cs_pos.h
```c
/*
 * cs_pos.h — distance filtering + 2D trilateration for Channel Sounding
 *
 * What it fixes:
 *  1. A timeout on one beacon no longer drops the fix: the last valid
 *     distance is used while it is younger than CS_POS_MAX_AGE_MS.
 *  2. Outliers (a jump > CS_POS_OUTLIER_M from the median) are rejected.
 *     If the next measurement agrees with the rejected one, that is real
 *     movement: the buffer restarts from these two values.
 *  3. Distance = median of the last CS_POS_WIN measurements.
 *  4. Position = least squares (works for 3+ beacons) + Gauss-Newton refinement,
 *     with a residual as the fix quality metric.
 *  5. Light EMA smoothing of the position.
 *
 * main.c uses 1-3 (cs_pos_add / cs_pos_dist); the position itself is still computed
 * with Sofia's trilateration. cs_pos_solve() is kept as an alternative solver.
 *
 * Units: distances in metres (as they arrive from CS), coordinates in mm.
 */
#ifndef CS_POS_H
#define CS_POS_H

#include <stdint.h>
#include <stdbool.h>

#define CS_POS_MAX_BEACONS   8
#define CS_POS_WIN           5      /* median window */
#define CS_POS_MAX_AGE_MS    10000  /* ~2 cycles: how long a distance stays valid after a timeout */
#define CS_POS_OUTLIER_M     0.30f  /* outlier threshold */
#define CS_POS_STALE_MS      6000   /* older than one cycle = stale */
#define CS_POS_EMA_ALPHA     0.5f   /* 1.0 = no smoothing */

typedef struct {
	float x_mm, y_mm;               /* beacon position */
	float buf[CS_POS_WIN];
	uint8_t n, head;
	float rejected;                 /* last rejected value, 0 = none */
	int64_t last_ms;                /* time of the last accepted measurement */
	bool ever;
} cs_beacon_t;

typedef struct {
	cs_beacon_t b[CS_POS_MAX_BEACONS];
	uint8_t count;
	float px, py;                   /* smoothed position */
	bool have_pos;
} cs_pos_t;

typedef struct {
	float x_mm, y_mm;
	float resid_mm;                 /* RMS residual: < ~100 mm good, > 250 mm suspicious */
	uint8_t used;                   /* how many beacons were used */
	uint8_t stale;                  /* how many of them came from an old value (after a timeout) */
} cs_fix_t;

void cs_pos_init(cs_pos_t *s, const float xy_mm[][2], uint8_t count);

/* Call on every CS result. valid=false for a timeout. */
void cs_pos_add(cs_pos_t *s, uint8_t idx, bool valid, float dist_m, int64_t now_ms);

/* Filtered distance; false if there is none or it is too old. */
bool cs_pos_dist(const cs_pos_t *s, uint8_t idx, int64_t now_ms, float *dist_m);

/* Compute a position. false if fewer than 3 fresh beacons. */
bool cs_pos_solve(cs_pos_t *s, int64_t now_ms, cs_fix_t *out);

#endif
```

## src/il_beacon.h
```c
/*
 * Beacon build only (CONFIG_IL_BEACON_ID > 0): reflector role of a beacon.
 */

#ifndef IL_BEACON_H_
#define IL_BEACON_H_

#include <stdbool.h>
#include <stddef.h>
#include <stdint.h>

/* Bluetooth company id of the manufacturer data in the beacon advertisement
 * (0xFFFF = reserved for tests).
 *
 * Manufacturer data = company id (2 bytes, little endian), then one entry per measured
 * beacon: <peer beacon id: 1 byte> <distance in mm: 2 bytes, little endian>.
 */
#define IL_ADV_COMPANY_ID 0xFFFF
#define IL_ADV_ENTRY_LEN  3

/**
 * @brief Advertise as "IL_B<id>" and answer the mobile node as a CS reflector. Never returns.
 *
 * @param dist_entries  Measured beacon distances, IL_ADV_ENTRY_LEN bytes each (see above).
 * @param len           Length of dist_entries in bytes (0 if nothing was measured).
 */
void il_reflector_run(const uint8_t *dist_entries, size_t len);

/** @brief true while a mobile node or another beacon is connected to this reflector. */
bool il_reflector_busy(void);

#endif /* IL_BEACON_H_ */
```

## src/il_cmd.c
```c
/*
 * Mobile node: UART receive side (text commands on the console, MAVLink from the flight
 * controller). See il_cmd.h.
 */

#include "il_cmd.h"

#if defined(CONFIG_IL_COMMANDS)

#include <stdlib.h>
#include <string.h>
#include <zephyr/kernel.h>
#include <zephyr/device.h>
#include <zephyr/devicetree.h>
#include <zephyr/drivers/uart.h>
#include <zephyr/sys/ring_buffer.h>
#include <zephyr/logging/log.h>

#include "mavlink_bridge.h"

LOG_MODULE_REGISTER(il_cmd, LOG_LEVEL_INF);

#define CONSOLE_NODE DT_CHOSEN(zephyr_console)

#if defined(CONFIG_IL_LASER_FROM_FC)
#define HAVE_MAVLINK_RX 1
#define MAVLINK_SHARES_CONSOLE DT_SAME_NODE(IL_MAVLINK_UART, CONSOLE_NODE)
#else
#define HAVE_MAVLINK_RX 0
#define MAVLINK_SHARES_CONSOLE 0
#endif

struct rx_port {
	const struct device *dev;
	struct ring_buf rb;
	uint8_t buf[512];
	uint32_t overruns;
};

static struct rx_port console_rx = {.dev = DEVICE_DT_GET(CONSOLE_NODE)};
#if HAVE_MAVLINK_RX && !MAVLINK_SHARES_CONSOLE
static struct rx_port mavlink_rx = {.dev = DEVICE_DT_GET(IL_MAVLINK_UART)};
#endif

static K_SEM_DEFINE(rx_sem, 0, 1);

static void uart_isr(const struct device *dev, void *user_data)
{
	struct rx_port *port = user_data;
	uint8_t tmp[32];

	if (!uart_irq_update(dev)) {
		return;
	}
	while (uart_irq_rx_ready(dev)) {
		int n = uart_fifo_read(dev, tmp, sizeof(tmp));

		if (n <= 0) {
			break;
		}
		if (ring_buf_put(&port->rb, tmp, n) < (uint32_t)n) {
			port->overruns++;
		}
	}
	k_sem_give(&rx_sem);
}

static bool start_port(struct rx_port *port)
{
	if (!device_is_ready(port->dev)) {
		LOG_ERR("UART %s not ready, no commands from it", port->dev->name);
		return false;
	}
	ring_buf_init(&port->rb, sizeof(port->buf), port->buf);
	if (uart_irq_callback_user_data_set(port->dev, uart_isr, port) != 0) {
		LOG_ERR("UART %s: no interrupt-driven RX", port->dev->name);
		return false;
	}
	uart_irq_rx_enable(port->dev);
	return true;
}

/* ---- text commands ---- */

static char line[96];
static size_t line_len;

static bool checksum_ok(const char *msg)
{
	/* msg starts after '$'; "*XX" at the end is optional */
	const char *star = strchr(msg, '*');

	if (star == NULL) {
		return true;
	}
	uint8_t cs = 0;

	for (const char *p = msg; p < star; p++) {
		cs ^= (uint8_t)*p;
	}
	return strtoul(star + 1, NULL, 16) == cs;
}

static void handle_line(char *s)
{
	char *start = strrchr(s, '$');

	if (start == NULL) {
		return;
	}
	start++;
	if (!checksum_ok(start)) {
		LOG_WRN("Command with a wrong checksum ignored");
		return;
	}
	char *star = strchr(start, '*');

	if (star) {
		*star = '\0';
	}

	if (strncmp(start, "MODE,", 5) == 0) {
		const char *m = start + 5;

		if (strcmp(m, "CAR") == 0 || strcmp(m, "car") == 0) {
			il_on_mode_command(IL_MODE_CAR);
		} else if (strcmp(m, "DRONE") == 0 || strcmp(m, "drone") == 0) {
			il_on_mode_command(IL_MODE_DRONE);
		} else {
			LOG_WRN("Unknown mode '%s' (CAR or DRONE)", m);
		}
	} else if (strncmp(start, "LSR,", 4) == 0) {
		char *p = start + 4;
		long range_mm = strtol(p, &p, 10);
		long roll_cdeg = (*p == ',') ? strtol(p + 1, &p, 10) : 0;
		long pitch_cdeg = (*p == ',') ? strtol(p + 1, &p, 10) : 0;
		const float cdeg_to_rad = 3.14159265f / 18000.0f;

		il_on_laser_sample(range_mm / 1000.0f, roll_cdeg * cdeg_to_rad,
				   pitch_cdeg * cdeg_to_rad);
	}
}

static void text_byte(uint8_t c)
{
	if (c == '\r' || c == '\n') {
		if (line_len > 0) {
			line[line_len] = '\0';
			handle_line(line);
			line_len = 0;
		}
		return;
	}
	if (c < 0x20 || c > 0x7e) {
		line_len = 0; /* binary (MAVLink on a shared UART): not a text line */
		return;
	}
	if (line_len < sizeof(line) - 1) {
		line[line_len++] = (char)c;
	} else {
		line_len = 0; /* too long: drop */
	}
}

static void rx_thread(void *a, void *b, void *c)
{
	ARG_UNUSED(a);
	ARG_UNUSED(b);
	ARG_UNUSED(c);
	uint8_t tmp[64];

	while (true) {
		k_sem_take(&rx_sem, K_MSEC(200));

		uint32_t n;

		while ((n = ring_buf_get(&console_rx.rb, tmp, sizeof(tmp))) > 0) {
			for (uint32_t i = 0; i < n; i++) {
				text_byte(tmp[i]);
				if (MAVLINK_SHARES_CONSOLE) {
					il_mavlink_rx_byte(tmp[i]);
				}
			}
		}
#if HAVE_MAVLINK_RX && !MAVLINK_SHARES_CONSOLE
		while ((n = ring_buf_get(&mavlink_rx.rb, tmp, sizeof(tmp))) > 0) {
			for (uint32_t i = 0; i < n; i++) {
				il_mavlink_rx_byte(tmp[i]);
			}
		}
#endif
	}
}

K_THREAD_STACK_DEFINE(rx_stack, 2048);
static struct k_thread rx_thread_data;

void il_cmd_init(void)
{
	bool any = start_port(&console_rx);

#if HAVE_MAVLINK_RX && !MAVLINK_SHARES_CONSOLE
	any = start_port(&mavlink_rx) || any;
#endif
	if (!any) {
		return;
	}
	k_thread_create(&rx_thread_data, rx_stack, K_THREAD_STACK_SIZEOF(rx_stack), rx_thread,
			NULL, NULL, NULL, 6, 0, K_NO_WAIT);
	k_thread_name_set(&rx_thread_data, "il_rx");
	LOG_INF("Commands on %s: $MODE,CAR / $MODE,DRONE / $LSR,<mm>,<roll cdeg>,<pitch cdeg>",
		console_rx.dev->name);
}

#endif /* CONFIG_IL_COMMANDS */
```

## src/il_cmd.h
```c
#pragma once

/*
 * Mobile node: receive side of the UARTs (CONFIG_IL_COMMANDS).
 *
 * Console (USB, or pins D6/D7 with uart_pins.overlay) - text commands, one per line, the
 * NMEA checksum "*XX" is optional (checked if present):
 *     $MODE,CAR            2D, beacons B1..B3 (B4 ignored)
 *     $MODE,DRONE          3D, all beacons, z with the laser
 *     $LSR,<range_mm>,<roll_cdeg>,<pitch_cdeg>
 *                          one laser rangefinder sample (if the rangefinder is read by the
 *                          Raspberry Pi instead of the flight controller; also for tests)
 * MAVLink UART RX (pin D7, CONFIG_IL_LASER_FROM_FC): bytes go to il_mavlink_rx_byte().
 * If both are the same UART, every byte goes to both parsers.
 */

#include "trilat_bridge.h"

#ifdef __cplusplus
extern "C" {
#endif

#if defined(CONFIG_IL_COMMANDS)
/** Starts the receive interrupts and the parser thread. */
void il_cmd_init(void);
#else
static inline void il_cmd_init(void) {}
#endif

/* Implemented in main.c */
void il_on_mode_command(enum il_mode mode);

#ifdef __cplusplus
}
#endif
```

## src/led_status.c
```c
/*
 * Status LED patterns, driven from the system work queue. See led_status.h.
 */
#include <zephyr/kernel.h>
#include <dk_buttons_and_leds.h>

#include "led_status.h"

#define STATUS_LED DK_LED1

/* on time, off time in ms for each blinking status */
static const uint16_t pattern[][2] = {
	[LED_STATUS_ON] = {0, 0},
	[LED_STATUS_MEASURING] = {100, 100},
	[LED_STATUS_LINKED] = {500, 500},
	[LED_STATUS_CONNECTED] = {100, 900},
	[LED_STATUS_OFF] = {0, 0},
};

static atomic_t current = ATOMIC_INIT(LED_STATUS_ON);
static bool led_on;

static void led_work_handler(struct k_work *work);
static K_WORK_DELAYABLE_DEFINE(led_work, led_work_handler);

static void led_work_handler(struct k_work *work)
{
	enum led_status s = (enum led_status)atomic_get(&current);

	if (s == LED_STATUS_OFF) {
		led_on = false;
		dk_set_led_off(STATUS_LED);
		return;
	}

	if (s == LED_STATUS_ON) {
		led_on = true;
		dk_set_led_on(STATUS_LED);
		return;
	}

	led_on = !led_on;
	dk_set_led(STATUS_LED, led_on);
	k_work_reschedule(&led_work, K_MSEC(led_on ? pattern[s][0] : pattern[s][1]));
}

void led_status_set(enum led_status status)
{
	if (atomic_get(&current) == LED_STATUS_OFF) {
		return; /* going to sleep: keep it off */
	}
	if (atomic_set(&current, status) == status) {
		return; /* no change, keep the running pattern */
	}
	k_work_reschedule(&led_work, K_NO_WAIT);
}

void led_status_init(void)
{
	atomic_set(&current, LED_STATUS_ON);
	k_work_reschedule(&led_work, K_NO_WAIT);
}
```

## src/led_status.h
```c
/*
 * Status LED (the one user LED of the XIAO).
 *
 * The LED is on as soon as the board runs, so a dark LED means no power or no firmware.
 * Blinking patterns on top of that show what the board is doing.
 */
#pragma once

enum led_status {
	LED_STATUS_ON,        /* steady: running (beacon: waiting for the mobile node) */
	LED_STATUS_MEASURING, /* fast blink, 5 Hz: beacon measures the other beacons */
	LED_STATUS_LINKED,    /* blink, 1 Hz: drone with all beacons connected */
	LED_STATUS_CONNECTED, /* short flash once a second: beacon with a connection */
	LED_STATUS_OFF,       /* off: going to sleep (sleep button) */
};

/* Call once after dk_leds_init(). Starts with LED_STATUS_ON. */
void led_status_init(void);
void led_status_set(enum led_status status);
```

## src/mavlink_bridge.cpp
```c
/*
 * Bridge between main.c and the team's MAVLink packer (../../../mavlink/mavlink_packer.cpp).
 * See mavlink_bridge.h.
 */

#include "mavlink_bridge.h"

#if defined(CONFIG_IL_MAVLINK)

#include <zephyr/kernel.h>
#include <zephyr/device.h>
#include <zephyr/drivers/uart.h>
#include <zephyr/logging/log.h>

#include <common/mavlink.h>
#include "mavlink_packer.hpp"

LOG_MODULE_REGISTER(il_mavlink, LOG_LEVEL_INF);

#if DT_SAME_NODE(IL_MAVLINK_UART, DT_CHOSEN(zephyr_console))
#warning "MAVLink and the text console share one UART: the packets are mixed with the text"
#endif

namespace {

const struct device *const uart_dev = DEVICE_DT_GET(IL_MAVLINK_UART);
bool ready;
K_MUTEX_DEFINE(tx_lock); /* heartbeat thread and main thread must not interleave packets */

void send(const uint8_t *buf, uint16_t len)
{
	k_mutex_lock(&tx_lock, K_FOREVER);
	for (uint16_t i = 0; i < len; i++) {
		uart_poll_out(uart_dev, buf[i]);
	}
	k_mutex_unlock(&tx_lock);
}

void heartbeat_thread(void *, void *, void *)
{
	uint8_t buf[MavlinkPacker::MAVLINK_PACKET_MAX];

	while (true) {
		k_sleep(K_MSEC(1000));
		if (ready) {
			send(buf, MavlinkPacker::pack_heartbeat(buf));
		}
	}
}

/* Attitude from the flight controller (ATTITUDE, #30) */
float att_roll, att_pitch;
int64_t att_time_ms = -100000;
uint32_t laser_samples, laser_no_attitude;

} // namespace

K_THREAD_DEFINE(il_mavlink_hb, 1024, heartbeat_thread, NULL, NULL, NULL, 7, 0, 0);

extern "C" bool il_mavlink_init(void)
{
	if (!device_is_ready(uart_dev)) {
		LOG_ERR("MAVLink UART %s is not ready", uart_dev->name);
		return false;
	}
	ready = true;
	LOG_INF("MAVLink output on %s", uart_dev->name);
	return true;
}

extern "C" void il_mavlink_send_position(float x_m, float y_m, float z_m, float sigma_xy_m,
					 float sigma_z_m)
{
	if (!ready) {
		return;
	}

	uint8_t buf[MavlinkPacker::MAVLINK_PACKET_MAX];
	const Point3D p = {x_m, y_m, z_m};
	uint64_t time_usec = (uint64_t)k_uptime_get() * 1000ULL; /* time since boot */

	send(buf, MavlinkPacker::pack_vision_position(p, time_usec, sigma_xy_m, sigma_z_m, buf));
}

extern "C" void il_mavlink_rx_byte(uint8_t c)
{
#if defined(CONFIG_IL_LASER_FROM_FC)
	static mavlink_message_t msg;
	static mavlink_status_t status;

	if (!mavlink_parse_char(MAVLINK_COMM_1, c, &msg, &status)) {
		return;
	}

	switch (msg.msgid) {
	case MAVLINK_MSG_ID_ATTITUDE: {
		mavlink_attitude_t a;

		mavlink_msg_attitude_decode(&msg, &a);
		att_roll = a.roll;
		att_pitch = a.pitch;
		att_time_ms = k_uptime_get();
		break;
	}
	case MAVLINK_MSG_ID_DISTANCE_SENSOR: {
		mavlink_distance_sensor_t d;

		mavlink_msg_distance_sensor_decode(&msg, &d);
		if (d.orientation != MAV_SENSOR_ROTATION_PITCH_270) {
			break; /* not looking down */
		}
		if (d.current_distance < d.min_distance || d.current_distance > d.max_distance) {
			break; /* out of range: no surface seen */
		}
		if (k_uptime_get() - att_time_ms > 500) {
			/* no fresh attitude: the tilt is unknown, do not guess */
			if ((laser_no_attitude++ % 100) == 0) {
				LOG_WRN("Laser samples without ATTITUDE from the flight controller "
					"(stream SRx_EXTRA1)");
			}
			break;
		}
		laser_samples++;
		il_on_laser_sample(d.current_distance / 100.0f, att_roll, att_pitch);
		break;
	}
	default:
		break;
	}
#else
	(void)c;
#endif
}

#endif /* CONFIG_IL_MAVLINK */
```

## src/mavlink_bridge.h
```c
#pragma once

/*
 * MAVLink link of the mobile node (CONFIG_IL_MAVLINK).
 *
 * TX: binary MAVLink v2 on its own UART (uart21 = pins D6 TX / D7 RX, 115200 baud); the text
 * output ($RNG, $POS, log) stays on the console (USB). Packets are made by the team's
 * ../../mavlink/mavlink_packer.cpp:
 *   - HEARTBEAT once a second (from its own thread),
 *   - VISION_POSITION_ESTIMATE after every computed position (with its uncertainty).
 *
 * RX (CONFIG_IL_LASER_FROM_FC): bytes from the flight controller (fed by il_cmd.c, which
 * owns the UART receive interrupts) are parsed; ATTITUDE and a downward DISTANCE_SENSOR
 * give the laser samples for the height (il_on_laser_sample() in main.c).
 */

#include <stdbool.h>
#include <stdint.h>
#include <zephyr/devicetree.h>

#ifdef __cplusplus
extern "C" {
#endif

#if defined(CONFIG_IL_MAVLINK)

/* The UART for MAVLink: the "il,mavlink-uart" chosen node if an overlay sets one,
 * otherwise uart21 (XIAO pins D6 = TX, D7 = RX).
 */
#if DT_HAS_CHOSEN(il_mavlink_uart)
#define IL_MAVLINK_UART DT_CHOSEN(il_mavlink_uart)
#else
#define IL_MAVLINK_UART DT_NODELABEL(uart21)
#endif

/* Starts the output (and the heartbeat). false if the UART is not ready. */
bool il_mavlink_init(void);

/* Position in meters, beacon frame (z up), and its 1-sigma uncertainty. */
void il_mavlink_send_position(float x_m, float y_m, float z_m, float sigma_xy_m,
			      float sigma_z_m);

/* One received byte from the flight controller. */
void il_mavlink_rx_byte(uint8_t c);

#else

static inline bool il_mavlink_init(void) { return true; }
static inline void il_mavlink_send_position(float x_m, float y_m, float z_m, float sigma_xy_m,
					    float sigma_z_m)
{
	(void)x_m; (void)y_m; (void)z_m; (void)sigma_xy_m; (void)sigma_z_m;
}
static inline void il_mavlink_rx_byte(uint8_t c) { (void)c; }

#endif

/* Implemented in main.c: one laser sample (range along the beam, attitude in radians). */
void il_on_laser_sample(float range_m, float roll_rad, float pitch_rad);

#ifdef __cplusplus
}
#endif
```

## src/sleep_button.c
```c
/*
 * Sleep button (D0 to GND, see boards/xiao_nrf54l15_nrf54l15_cpuapp.overlay).
 *
 * Press: the LED goes off, the RF switch is powered down and the chip enters System OFF
 * (a few uA). Press again: the chip wakes up and starts from the beginning, like after
 * power-on (a beacon measures the other beacons again, the drone looks for the beacons).
 */
#include <zephyr/kernel.h>
#include <zephyr/init.h>
#include <zephyr/drivers/gpio.h>
#include <zephyr/logging/log.h>
#include <zephyr/sys/poweroff.h>
#include <dk_buttons_and_leds.h>

#include "led_status.h"

LOG_MODULE_REGISTER(sleep_button, LOG_LEVEL_INF);

#define USER_NODE DT_PATH(zephyr_user)

#if IS_ENABLED(CONFIG_IL_SLEEP_BUTTON) && DT_NODE_HAS_PROP(USER_NODE, sleep_button_gpios)

#define DEBOUNCE_MS 30

static const struct gpio_dt_spec button = GPIO_DT_SPEC_GET(USER_NODE, sleep_button_gpios);
static struct gpio_callback button_cb;

static void rf_switch_off(void)
{
	const struct device *gpio2 = DEVICE_DT_GET(DT_NODELABEL(gpio2));

	/* P2.03 powers the RF switch, P2.05 selects the antenna (see antenna.c) */
	gpio_pin_configure(gpio2, 3, GPIO_OUTPUT_LOW);
	gpio_pin_configure(gpio2, 5, GPIO_OUTPUT_LOW);
}

static void sleep_work_handler(struct k_work *work)
{
	k_msleep(DEBOUNCE_MS);
	if (gpio_pin_get_dt(&button) != 1) {
		/* a glitch, not a press */
		gpio_pin_interrupt_configure_dt(&button, GPIO_INT_EDGE_TO_ACTIVE);
		return;
	}

	LOG_INF("Sleep button: going to sleep, press it again to wake up");
	led_status_set(LED_STATUS_OFF);
	dk_set_led_off(DK_LED1);

	/* Wait for the release, otherwise the still pressed button wakes the chip at once */
	while (gpio_pin_get_dt(&button) == 1) {
		k_msleep(10);
	}
	k_msleep(DEBOUNCE_MS);

	rf_switch_off();

	/* Wake-up source: the button pressed (pin low) */
	gpio_pin_interrupt_configure_dt(&button, GPIO_INT_LEVEL_ACTIVE);

	k_msleep(100); /* let the log go out */
	sys_poweroff();
}

static K_WORK_DEFINE(sleep_work, sleep_work_handler);

static void button_pressed(const struct device *dev, struct gpio_callback *cb, uint32_t pins)
{
	gpio_pin_interrupt_configure_dt(&button, GPIO_INT_DISABLE);
	k_work_submit(&sleep_work);
}

static int sleep_button_init(void)
{
	int err;

	if (!gpio_is_ready_dt(&button)) {
		LOG_ERR("Sleep button GPIO not ready");
		return -ENODEV;
	}

	err = gpio_pin_configure_dt(&button, GPIO_INPUT);
	if (err) {
		LOG_ERR("Sleep button configure error %d", err);
		return err;
	}

	gpio_init_callback(&button_cb, button_pressed, BIT(button.pin));
	gpio_add_callback_dt(&button, &button_cb);

	/* Edge, not level: a button still held after the wake-up does not send it back to sleep */
	return gpio_pin_interrupt_configure_dt(&button, GPIO_INT_EDGE_TO_ACTIVE);
}

SYS_INIT(sleep_button_init, APPLICATION, CONFIG_APPLICATION_INIT_PRIORITY);

#endif
```
