## cs/cs_multi_initiator/b1log/cs_multi_initiator/Kconfig/boards/Kconfig.defconfig
```kconfig
# Load Zephyr board defconfig descriptions.
osource "C:/ncs/v3.4.2/zephyr/boards/seeed/xiao_nrf54l15/Kconfig.defconfig"
```

## cs/cs_multi_initiator/b3log/Kconfig/boards/Kconfig.tmp
```kconfig
# Load Zephyr board Kconfig descriptions.
osource "C:/ncs/v3.4.2/zephyr/boards/seeed/xiao_nrf54l15/Kconfig"
```
