## CMakeLists.txt
```
cmake_minimum_required(VERSION 3.20.0)

find_package(Zephyr REQUIRED HINTS $ENV{ZEPHYR_BASE})
project(uart_test)

target_sources(app PRIVATE
    src/main.cpp
    ../uart/uart_sender.cpp
)

target_include_directories(app PRIVATE
    ../uart
)
```

## prj.conf
```kconfig
CONFIG_CPP=y
CONFIG_STD_CPP17=y
CONFIG_SERIAL=y
CONFIG_GPIO=y
CONFIG_CONSOLE=n
CONFIG_UART_CONSOLE=n
CONFIG_CBPRINTF_FP_A_SUPPORT=y
```

## src/main.cpp
```c
#include <zephyr/kernel.h>
#include "uart_sender.hpp"

int main(void)
{
    if (!UartSender::init()) {
        return 1;
    }

    const uint8_t test_data[] = {0xFD, 0x01, 0x02, 0x03};

    while (true) {
        if (UartSender::send(test_data, sizeof(test_data))) {
            UartSender::blink_led();
        }

        k_msleep(100);
    }

    return 0;
}
```
